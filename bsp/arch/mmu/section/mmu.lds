SECTIONS { 
  firtst    0x00000000 : { head.o init.o }  
  /*head.o和init.o组成，加载地址和运行地址都是0，运行前不需要重新移动代码*/

  second    0xB0004000 : AT(2048) { leds.o }

  /*由leds.o组成，加载地址为2048，重定位地址为0xB0004000,表明段second
   *存放在编译所得映象文件地址2048处，在运行前将它复制到地址0xB0004000处，
   *这由init.c中的copn_2th_to_sdram函数完成。(此函数将代码复制开始地址为，
   *0x30004000的内存中，这是开启MMU后虚拟地址0xB0004000对应的物理地址)*/
}